## BLE_Adv_test/boards/board.yml
```yaml
board:
  name: nrf52840_custom_board_v7
  full_name: nRF52840_custom_board_v7
  vendor: nordic
  socs:
  - name: nrf52840
```

## BLE_Conn_test/boards/board.yml
```yaml
board:
  name: nrf52840_custom_board_v8
  full_name: nRF52840_custom_board_v8
  vendor: nordic
  socs:
  - name: nrf52840
```

## BLE_GATT_test/boards/board.yml
```yaml
board:
  name: nrf52840_custom_board_v9
  full_name: nRF52840_custom_board_v9
  vendor: nordic
  socs:
  - name: nrf52840
```
